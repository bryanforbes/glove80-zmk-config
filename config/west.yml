## config/west.yml
```yaml
manifest:
  defaults:
    remote: bryanforbes

  remotes:
    - name: bryanforbes
      url-base: https://github.com/bryanforbes
    - name: moergo-sc
      url-base: https://github.com/moergo-sc
    - name: urob
      url-base: https://github.com/urob

  projects:
    - name: zmk
      remote: moergo-sc
      revision: 2f73a230e2fc7b2bd64a9736181e87bf54338131
      import: app/west.yml

    # ZMK modules
    - name: zmk-helpers
      remote: urob
      revision: v0.3
      path: modules/zmk/helpers
    - name: zmk-tri-state
      remote: urob
      revision: v0.3
      path: modules/zmk/tri-state

  self:
    path: config
```
